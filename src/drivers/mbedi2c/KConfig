## src/drivers/mbedi2c/KConfig
```kconfig
menuconfig DRIVERS_MBEDI2C
	bool "mbedi2c"
	default n
	---help---
		Enable support for i2c communication with mbed
```

## src/drivers/mbedi2c/Kconfig
```kconfig
menuconfig DRIVERS_MBEDI2C
	bool "mbedi2c"
	default n
	---help---
		Enable mbedi2c drivers
```

## src/examples/reset_bias/KConfig
```kconfig
menuconfig EXAMPLES_RESET_BIAS
	bool "reset_bias"
	default n
	---help---
		Publish message to reset load cell bias
```

## src/examples/reset_bias/Kconfig
```kconfig
menuconfig EXAMPLES_RESET_BIAS
	bool "reset_bias"
	default n
	---help---
		Enable support for myapp
```

## src/modules/mc_int_control/Kconfig
```kconfig
menuconfig MODULES_MC_INT_CONTROL
	bool "mc_int_control"
	default n
	---help---
		Enable support for mc_int_control

menuconfig USER_MC_INT_CONTROL
	bool "mc_INT_control running as userspace module"
	default y
	depends on BOARD_PROTECTED && MODULES_MC_INT_CONTROL
	---help---
		Put mc_int_control in userspace memory
```
